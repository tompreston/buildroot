## configs/qemu_x86_64_defconfig
```kconfig
BR2_x86_64=y
BR2_TOOLCHAIN_BUILDROOT_GLIBC=y
BR2_PACKAGE_HOST_LINUX_HEADERS_CUSTOM_4_16=y
BR2_TOOLCHAIN_BUILDROOT_CXX=y
BR2_TARGET_GENERIC_GETTY_PORT="tty1"
BR2_SYSTEM_DHCP="eth0"
BR2_LINUX_KERNEL=y
BR2_LINUX_KERNEL_CUSTOM_VERSION=y
BR2_LINUX_KERNEL_CUSTOM_VERSION_VALUE="4.16.7"
BR2_LINUX_KERNEL_USE_CUSTOM_CONFIG=y
BR2_LINUX_KERNEL_CUSTOM_CONFIG_FILE="board/qemu/x86_64/linux.config"
BR2_PACKAGE_CHROMIUM=y
BR2_PACKAGE_MESA3D=y
BR2_PACKAGE_XORG7=y
BR2_PACKAGE_CUPS=y
BR2_TARGET_ROOTFS_EXT2=y
# BR2_TARGET_ROOTFS_TAR is not set
```

## package/at-spi2-atk/Config.in
```kconfig
config BR2_PACKAGE_AT_SPI2_ATK
	bool "at-spi2-atk"
	select BR2_PACKAGE_AT_SPI2_CORE
	help
	  The At-Spi2 Atk package contains a library that bridges ATK to At-Spi2 D-Bus service.
```

## package/at-spi2-core/Config.in
```kconfig
config BR2_PACKAGE_AT_SPI2_CORE
	bool "at-spi2-core"
	select BR2_PACKAGE_DBUS
	select BR2_PACKAGE_XLIB_LIBXTST
	help
	  The At-Spi2 Core package is a part of the GNOME Accessibility Project.
	  It provides a Service Provider Interface for the Assistive Technologies
	  available on the GNOME platform and a library against which 
	  applications can be linked.
```

## package/chromium/Config.in
```kconfig
config BR2_PACKAGE_CHROMIUM_ARCH_SUPPORTS
	bool
	default y if BR2_arm
	default y if BR2_aarch64
	default y if BR2_i386
	default y if BR2_x86_64

config BR2_PACKAGE_CHROMIUM_TARGET_ARCH
	string
	default "arm" if BR2_arm
	default "arm64" if BR2_aarch64
	default "x86" if BR2_i386
	default "x64" if BR2_x86_64

menuconfig BR2_PACKAGE_CHROMIUM
	bool "chromium"
	depends on BR2_HOST_GCC_AT_LEAST_4_9 # gn requires -std=c++14
	depends on BR2_PACKAGE_HAS_LIBGL
	depends on BR2_PACKAGE_XORG7
	depends on BR2_TOOLCHAIN_USES_GLIBC
	select BR2_PACKAGE_AT_SPI2_ATK
	select BR2_PACKAGE_ALSA_LIB
	select BR2_PACKAGE_FREETYPE
	select BR2_PACKAGE_HARFBUZZ
	select BR2_PACKAGE_HOST_CLANG
	select BR2_PACKAGE_HOST_LLD
	select BR2_PACKAGE_HOST_NINJA
	select BR2_PACKAGE_HOST_NODEJS
	select BR2_PACKAGE_HOST_PYTHON
	select BR2_PACKAGE_JPEG
	select BR2_PACKAGE_LIBDRM
	select BR2_PACKAGE_LIBERATION # runtime
	select BR2_PACKAGE_LIBGLIB2
	select BR2_PACKAGE_LIBGTK2 if !BR2_PACKAGE_LIBGTK3_X11
	select BR2_PACKAGE_LIBKRB5
	select BR2_PACKAGE_LIBNSS
	select BR2_PACKAGE_LIBPNG
	select BR2_PACKAGE_XLIB_LIBXCOMPOSITE
	select BR2_PACKAGE_XLIB_LIBXCURSOR
	select BR2_PACKAGE_XLIB_LIBXI if !BR2_PACKAGE_LIBGTK3_X11
	select BR2_PACKAGE_XLIB_LIBXRANDR
	select BR2_PACKAGE_XLIB_LIBXSCRNSAVER
	select BR2_PACKAGE_XLIB_LIBXTST if !BR2_PACKAGE_LIBGTK3_X11
	help
	  Chromium is an open-source Web browser project started by
	  Google, to provide the source code for the proprietary
	  Google Chrome browser.

if BR2_PACKAGE_CHROMIUM

config BR2_PACKAGE_CHROMIUM_PROPRIETARY_CODECS
	bool "Enable proprietary codecs"
	help
	  Enables proprietary codecs with additional licensing
	  restrictions, such as MP3 and H264

endif # BR2_PACKAGE_CHROMIUM

comment "chromium needs toolchain w/ Glibc, host gcc >= 4.9.0"
	depends on !BR2_TOOLCHAIN_USES_GLIBC \
		|| !BR2_HOST_GCC_AT_LEAST_4_9

comment "chromium depends on X.org and needs an OpenGL backend"
	depends on !BR2_PACKAGE_XORG7 || !BR2_PACKAGE_HAS_LIBGL
```

## package/emscripten/Config.in.host
```kconfig
config BR2_PACKAGE_HOST_EMSCRIPTEN
	bool "host emscripten"
	select BR2_PACKAGE_HOST_LLVM
	select BR2_PACKAGE_HOST_CLANG
	help
	  Emscripten
```
